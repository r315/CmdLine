# AT32F415xx register map
Vendor: Keil; Series: AT32F415; File version: 1.0
ARM 32-bit Cortex-M4 Microcontroller based device, CPU clock up to 120MHz, etc.
CPU: CM4 r0p1, little endian, no MPU, FPU, 4 interrupt priority bits
Registers are 32-bit, read-write, reset 0x0 unless marked. A register's access mark holds for its fields unless they carry their own. Offsets are from the block's base; lines under a group give offsets from that group; [hi:lo] are bit positions; {n}, {i} and the like mark numbered series; 'fields as' and 'values as' point back to an identical list; <NAME> marks a mode.

## Memory map
0x40000000 TMR2 size 0x400 — General purpose timer
0x40000400 TMR3 size 0x400 — General purpose timer
0x40000800 TMR4 size 0x400
0x40000C00 TMR5 size 0x400
0x40002400 COMP size 0x400 — Compare
0x40002800 ERTC size 0x400 — Real-time clock
0x40002C00 WWDG size 0x400 — Window watchdog
0x40003000 IWDG size 0x400 — Independent watchdog
0x40003800 SPI2 size 0x400
0x40004400 USART2 size 0x400
0x40004800 USART3 size 0x400
0x40004C00 UART4 size 0x400 — Universal asynchronous receiver transmitter
0x40005000 UART5 size 0x400 — Universal asynchronous receiver transmitter
0x40005400 I2C1 size 0x400 — Inter integrated circuit
0x40005800 I2C2 size 0x400
0x40006400 CAN size 0x400 — Controller area network
0x40007000 PWR size 0x400 — Power control
0x40010000 AFIO size 0x400 — Alternate function I/O
0x40010400 EXTI size 0x400
0x40010800 GPIOA size 0x400 — General purpose I/O
0x40010C00 GPIOB size 0x400
0x40011000 GPIOC size 0x400
0x40011400 GPIOD size 0x400
0x40011C00 GPIOF size 0x400
0x40012400 ADC1 size 0x400 — Analog to digital converter
0x40012C00 TMR1 size 0x400 — Advanced timer
0x40013000 SPI1 size 0x400 — Serial peripheral interface
0x40013800 USART1 size 0x400 — Universal synchronous asynchronous receiver transmitter
0x40014C00 TMR9 size 0x400 — General purpose timer
0x40015000 TMR10 size 0x400 — General purpose timer
0x40015400 TMR11 size 0x400
0x40015800 ACC size 0x400 — HSI Auto Clock Calibration
0x40018000 SDIO1 size 0x400 — Secure digital input/output interface
0x40020000 DMA1 size 0x400 — DMA controller
0x40020400 DMA2 size 0x400
0x40021000 RCC size 0x400 — Reset and clock control
0x40022000 EFC size 0x400
0x40023000 CRC size 0x400 — CRC calculation unit
0x50000000 USB_OTG_GLOBAL size 0x400 — USB on the go full speed
0x50000400 USB_OTG_HOST size 0x400 — USB on the go full speed
0x50000800 USB_OTG_DEVICE size 0x400 — USB on the go full speed
0x50000E00 USB_OTG_PWRCLK size 0x400 — USB on the go full speed
0xE000E000 NVIC size 0x1001 — Nested Vectored Interrupt Controller
0xE0042000 MCUDBG size 0x400 — Debug support

## Interrupts
0 WWDG — Window Watchdog interrupt
1 PVD (PWR) — PVD through EXTI line detection interrupt
2 TAMPER (EXTI) — Tamper interrupt
3 ERTC_WKUP (ERTC) — ERTC Wakeup interrupt through the EXTI line
4 EFLASH (EFC) — EFlash global interrupt
5 RCC — RCC global interrupt
6 EXTINT0 (EXTI) — EXTI Line0 interrupt
7 EXTINT1 (EXTI) — EXTI Line1 interrupt
8 EXTINT2 (EXTI) — EXTI Line2 interrupt
9 EXTINT3 (EXTI) — EXTI Line3 interrupt
10 EXTINT4 (EXTI) — EXTI Line4 interrupt
11 DMA1_Channel1 (DMA1) — DMA1 Channel1 global interrupt
12 DMA1_Channel2 (DMA1) — DMA1 Channel2 global interrupt
13 DMA1_Channel3 (DMA1) — DMA1 Channel3 global interrupt
14 DMA1_Channel4 (DMA1) — DMA1 Channel4 global interrupt
15 DMA1_Channel5 (DMA1) — DMA1 Channel5 global interrupt
16 DMA1_Channel6 (DMA1) — DMA1 Channel6 global interrupt
17 DMA1_Channel7 (DMA1) — DMA1 Channel7 global interrupt
18 ADC1_2 (ADC1) — ADC1 and ADC2 global interrupt
19 CAN_TX (CAN) — CAN1 TX interrupts
20 CAN_RXS0 (CAN) — CAN1 RX0 interrupts
21 CAN_RXS1 (CAN) — CAN1 RX1 interrupt
22 CAN_SCE (CAN) — CAN1 SCE interrupt
23 EXTINT9_5 (EXTI) — EXTI Line[9:5] interrupts
24 TIM1_BRK (TMR1, TMR9) — TIM1 Break interrupt and TIM9 global interrupt
25 TIM1_UP (TMR1, TMR10) — TIM1 Update interrupt and TIM10 global interrupt
26 TIM1_TRG_COM (TMR1, TMR11) — TIM1 Trigger and Commutation interrupts and TIM11 global interrupt
27 TIM1_CC (TMR1) — TIM1 Capture Compare interrupt
28 TIM2 (TMR2) — TIM2 global interrupt
29 TIM3 (TMR3) — TIM3 global interrupt
30 TIM4 (TMR4) — TIM4 global interrupt
31 I2C1_EV (I2C1) — I2C1 event interrupt
32 I2C1_ER (I2C1) — I2C1 error interrupt
33 I2C2_EV (I2C2) — I2C2 event interrupt
34 I2C2_ER (I2C2) — I2C2 error interrupt
35 SPI1 — SPI1 global interrupt
36 SPI2 — SPI2 global interrupt
37 USART1 — USART1 global interrupt
38 USART2 — USART2 global interrupt
39 USART3 — USART3 global interrupt
40 EXTINT15_10 (EXTI) — EXTI Line[15:10] interrupts
41 ERTC_Alarm (ERTC) — ERTC Alarms (A and B) through EXTI line interrupt
49 SDIO1 — SDIO1 global interrupt
50 TIM5 (TMR5) — TIM5 global interrupt
52 UART4 — UART4 global interrupt
53 UART5 — UART5 global interrupt
56 DMA2_Channel1 (DMA2) — DMA2 Channel1 global interrupt
57 DMA2_Channel2 (DMA2) — DMA2 Channel2 global interrupt
58 DMA2_Channel3 (DMA2) — DMA2 Channel3 global interrupt
59 DMA2_Channel4_5 (DMA2) — DMA2 Channel4 and DMA2 Channel5 global interrupt
67 OTG_FS (USB_OTG_GLOBAL) — USB On The Go FS global interrupt
70 COMP1 (COMP) — COMP1 interrupt
71 COMP2 (COMP) — COMP2 interrupt
72 ACC — ACC global interrupt

## Licence text in the file
ARM Limited (ARM) is supplying this software for use with Cortex-M processor based microcontroller, but can be equally used for other suitable processor architectures. This file can be freely distributed. Modifications to this file shall be clearly marked. . THIS SOFTWARE IS PROVIDED "AS IS". NO WARRANTIES, WHETHER EXPRESS, IMPLIED. OR STATUTORY, INCLUDING, BUT NOT LIMITED TO, IMPLIED WARRANTIES OF. MERCHANTABILITY AND FITNESS FOR A PARTICULAR PURPOSE APPLY TO THIS SOFTWARE. ARM SHALL NOT, IN ANY CIRCUMSTANCES, BE LIABLE FOR SPECIAL, INCIDENTAL, OR. CONSEQUENTIAL DAMAGES, FOR ANY REASON WHATSOEVER.

## Notices in the file
Copyright (C) 2012-2014 ARM Limited. All rights reserved.
Purpose: System Viewer Description (SVD) Example (Schema Version 1.1)
This is a description of a none-existent and incomplete device
for demonstration purposes only.
Redistribution and use in source and binary forms, with or without
modification, are permitted provided that the following conditions are met:
- Redistributions of source code must retain the above copyright
notice, this list of conditions and the following disclaimer.
- Redistributions in binary form must reproduce the above copyright
notice, this list of conditions and the following disclaimer in the
documentation and/or other materials provided with the distribution.
- Neither the name of ARM nor the names of its contributors may be used
to endorse or promote products derived from this software without
specific prior written permission.
THIS SOFTWARE IS PROVIDED BY THE COPYRIGHT HOLDERS AND CONTRIBUTORS "AS IS"
AND ANY EXPRESS OR IMPLIED WARRANTIES, INCLUDING, BUT NOT LIMITED TO, THE
ARE DISCLAIMED. IN NO EVENT SHALL COPYRIGHT HOLDERS AND CONTRIBUTORS BE
LIABLE FOR ANY DIRECT, INDIRECT, INCIDENTAL, SPECIAL, EXEMPLARY, OR
CONSEQUENTIAL DAMAGES (INCLUDING, BUT NOT LIMITED TO, PROCUREMENT OF
SUBSTITUTE GOODS OR SERVICES; LOSS OF USE, DATA, OR PROFITS; OR BUSINESS
INTERRUPTION) HOWEVER CAUSED AND ON ANY THEORY OF LIABILITY, WHETHER IN
CONTRACT, STRICT LIABILITY, OR TORT (INCLUDING NEGLIGENCE OR OTHERWISE)
ARISING IN ANY WAY OUT OF THE USE OF THIS SOFTWARE, EVEN IF ADVISED OF THE
POSSIBILITY OF SUCH DAMAGE.
